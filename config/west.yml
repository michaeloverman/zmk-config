## config/west.yml
```yaml
manifest:
  remotes:
    - name: michaeloverman
      url-base: https://github.com/michaeloverman
  projects:
    - name: zmk-config
      remote: michaeloverman
      revision: main
  self:
    path: config
```
